## Documentation/devicetree/bindings/w1/amd,axi-1wire-master.yaml
```yaml
# SPDX-License-Identifier: (GPL-2.0-only OR BSD-2-Clause)
%YAML 1.2
---
$id: http://devicetree.org/schemas/w1/amd,axi-1wire-master.yaml#
$schema: http://devicetree.org/meta-schemas/core.yaml#

title: AMD AXI 1-wire bus master for Programmable Logic

maintainers:
  - Thomas Delev <thomas.delev@amd.com>

properties:
  compatible:
    const: amd,axi-1wire-master

  reg:
    maxItems: 1

  interrupts:
    maxItems: 1

required:
  - compatible
  - reg
  - interrupts

additionalProperties: false

examples:
  - |
    #include <dt-bindings/interrupt-controller/arm-gic.h>

    onewire@a0000000 {
        compatible = "amd,axi-1wire-master";
        reg = <0xa0000000 0x10000>;
        interrupts = <GIC_SPI 0x59 IRQ_TYPE_LEVEL_HIGH>;
    };

...
```
